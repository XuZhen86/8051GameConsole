#ifndef __LCD12864_H_
#define __LCD12864_H_

#include<Main/STC15W4K48S4.h>
#include<PWM/PWM.h>
#include<Main/Universal.h>
#include<SPI/SPI.h>

void lcd12864GdramFlush();
#include<Timer/Timer.h>

unsigned char code
    LCD12864_CLEAR=0x01,
    LCD12864_STANDBY=0x01,
    LCD12864_HOME=0x02,
    LCD12864_RAM_ADDR_SELECT=0x02,
    LCD12864_ENTRY_MODE=0X04,
    LCD12864_DISPLAY_ON_OFF=0x08,
    LCD12864_CURSOR_DISPLAY_CONTROL=0x10,
    LCD12864_FUNCTION_SET=0x30,
    LCD12864_SET_CGRAM_ADDR=0x40,
    LCD12864_SET_DDRAM_ADDR=0x80,
    LCD12864_SET_GDRAM_ADDR=0x80;
unsigned char code LCD12864_ASCII5x8[128][8]={
    {0x00,0x00,0x70,0x50,0x50,0x70,0x00,0x00},
    {0x00,0x00,0x70,0x50,0x50,0x70,0x00,0x00},
    {0,80,80,0,136,112,0,0},
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    {0xa8,0x50,0xa8,0x50,0xa8,0x50,0xa8,0x00}};
unsigned char code LCD12864_BUFFER_INIT_VALUE=0x00;

unsigned char xdata lcd12864GdramBuffer[32][32][2];
bit lcd12864GdramNeedsFlush,lcd12864GdramAccessLock=1;
unsigned int lcd12864Brightness=0x1fff;

unsigned char code lcd12864ChipSelectP2M0=0x40,
                   lcd12864ChipSelectP2M1=0x00; // CS 推挽输出
sbit lcd12864ChipSelect=P2^6;
sbit lcd12864ResetSignal=P2^7;

void lcd12864SpiSend(bit b,unsigned char c);
void lcd12864SpiSend2Bytes(bit b,unsigned char c1,unsigned char c2);
void lcd12864HwReset();
void lcd12864GdramFlush();
void lcd12864SpiInitialize();
void lcd12864PwmInitialize();
void lcd12864TimerInitialize();
void lcd12864BrightnessSet(unsigned int brightness);
unsigned int lcd12864BrightnessGet();
void lcd12864CharSet(unsigned char row,unsigned char col,unsigned char c,bit flush);
void lcd12864StringSet(unsigned char row,unsigned char col,unsigned char *str,bit flush);
void lcd12864PixelSet(unsigned char row,unsigned char col,bit lightUp,bit flush);
bit lcd12864PixelGet(unsigned char row,unsigned char col,bit frame);
void lcd12864FlushAtNextUpdate();

void lcd12864SpiSend(bit b,unsigned char c){
    if(!spiGetOccupied()){
        spiSetup(1,1,3);
        spiSetOccupied(1);

        lcd12864ChipSelect=1;

        spiSend(b?0xfa:0xf8);
        spiSend(c&0xf0);
        spiSend(c<<4);

        while(!spiTransmissionComplete());
        lcd12864ChipSelect=0;
        delayBusy(0,0,50);

        spiSetOccupied(0);
    }
}

void lcd12864SpiSend2Bytes(bit b,unsigned char c1,unsigned char c2){
    if(!spiGetOccupied()){
        spiSetup(1,1,3);
        spiSetOccupied(1);

        lcd12864ChipSelect=1;

        spiSend(b?0xfa:0xf8);
        spiSend(c1&0xf0);
        spiSend(c1<<4);
        spiSend(b?0xfa:0xf8);
        spiSend(c2&0xf0);
        spiSend(c2<<4);

        while(!spiTransmissionComplete());
        lcd12864ChipSelect=0;
        delayBusy(0,0,50);

        spiSetOccupied(0);
    }
}

void lcd12864HwReset(){
    lcd12864GdramAccessLock=1;

    lcd12864ResetSignal=0;
    delayBusy(1,146,229);

    lcd12864ResetSignal=1;
    delayBusy(1,146,229);

    lcd12864GdramAccessLock=0;
}

void lcd12864SpiInitialize(){
    unsigned char i,j;

    lcd12864ChipSelect=0;
    P2M0=lcd12864ChipSelectP2M0;
    P2M1=lcd12864ChipSelectP2M1;

    lcd12864HwReset();
    lcd12864SpiSend(0,LCD12864_FUNCTION_SET|0x04);
    for(i=0;i<32;i++){
        lcd12864SpiSend2Bytes(0,LCD12864_SET_GDRAM_ADDR|i,LCD12864_SET_GDRAM_ADDR);
        for(j=0;j<32;j+=2){
            lcd12864GdramBuffer[i][j][0]=LCD12864_BUFFER_INIT_VALUE;
            lcd12864GdramBuffer[i][j][1]=LCD12864_BUFFER_INIT_VALUE;
            lcd12864GdramBuffer[i][j+1][0]=LCD12864_BUFFER_INIT_VALUE;
            lcd12864GdramBuffer[i][j+1][1]=LCD12864_BUFFER_INIT_VALUE;
            lcd12864SpiSend2Bytes(1,lcd12864GdramBuffer[i][j][0],lcd12864GdramBuffer[i][j+1][0]);
        }
    }
    lcd12864SpiSend(0,LCD12864_FUNCTION_SET|0x04|0x02);

    lcd12864PwmInitialize();
    lcd12864TimerInitialize();

    lcd12864GdramAccessLock=0;
}

void lcd12864PwmInitialize(){
    pwmEnable();
    pwm3Initialize(1,1,0,0,0,lcd12864Brightness);    // brightness
    pwmStart();
}

void lcd12864TimerInitialize(){
    timer4Initialize(1,0x3c,0xb0);  // 20 ms @ 30MHz
    timer4Start();
}

void lcd12864GdramFlush(){
    unsigned char i,j;
    bit graphicDisplayDisabled=0,addressJustBeenSent=0;

    if(lcd12864GdramNeedsFlush&&!lcd12864GdramAccessLock){
        for(i=0;i<32;i++){
            for(j=0;j<32;j+=2){
                if(lcd12864GdramBuffer[i][j][0]!=lcd12864GdramBuffer[i][j][1]
                    ||lcd12864GdramBuffer[i][j+1][0]!=lcd12864GdramBuffer[i][j+1][1]){
                    if(!graphicDisplayDisabled){
                        graphicDisplayDisabled=1;
                        lcd12864SpiSend(0,LCD12864_FUNCTION_SET|0x04);
                    }

                    lcd12864GdramBuffer[i][j][0]=lcd12864GdramBuffer[i][j][1];
                    lcd12864GdramBuffer[i][j+1][0]=lcd12864GdramBuffer[i][j+1][1];

                    if(!addressJustBeenSent){
                        lcd12864SpiSend2Bytes(0,LCD12864_SET_GDRAM_ADDR|i,LCD12864_SET_GDRAM_ADDR|j/2);
                        addressJustBeenSent=1;
                    }

                    lcd12864SpiSend2Bytes(1,lcd12864GdramBuffer[i][j][0],lcd12864GdramBuffer[i][j+1][0]);
                }else{
                    addressJustBeenSent=0;
                }
            }
        }

        if(graphicDisplayDisabled){
            lcd12864SpiSend(0,LCD12864_FUNCTION_SET|0x04|0x02);
        }
        lcd12864GdramNeedsFlush=0;
    }
}

void lcd12864BrightnessSet(unsigned int brightness){
    if(brightness==0){
        brightness=1;
    }
    lcd12864Brightness=brightness;
    pwm3TimerValueSet(0,brightness);
}

unsigned int lcd12864BrightnessGet(){
    return lcd12864Brightness;
}

void lcd12864CharSet(unsigned char row,unsigned char col,unsigned char c,bit flush){
    unsigned char i;
    lcd12864GdramAccessLock=1;
    lcd12864GdramNeedsFlush|=flush;

    col=col%25*5;
    row=row%8*8;
    col+=(row>31)*128;
    row%=32;

    // if(row>31){
    //     col+=128;
    //     row-=32;
    // }

    for(i=row;i<row+8;i++){
        lcd12864GdramBuffer[i][col/8][1]&=(0xff<<(8-col%8));
        lcd12864GdramBuffer[i][col/8][1]|=(LCD12864_ASCII5x8[c][i%8]>>(col%8));

        lcd12864GdramBuffer[i][col/8+1][1]&=(0xff>>(col%8));
        lcd12864GdramBuffer[i][col/8+1][1]|=(LCD12864_ASCII5x8[c][i%8]<<(8-col%8));
    }

    lcd12864GdramAccessLock=0;
}

void lcd12864StringSet(unsigned char row,unsigned char col,unsigned char *str,bit flush){
    unsigned int i;
    for(i=0;str[i];i++){
        lcd12864CharSet(row,col+i,str[i],flush);
    }
}

void lcd12864PixelSet(unsigned char row,unsigned char col,bit lightUp,bit flush){
    lcd12864GdramAccessLock=1;
    lcd12864GdramNeedsFlush|=flush;

    row%=64;
    col%=128;
    col+=(row>31)*128;
    row%=32;

    if(lightUp){
        lcd12864GdramBuffer[row][col/8][1]|=(0x80>>col%8);
    }else{
        lcd12864GdramBuffer[row][col/8][1]&=~(0x80>>col%8);
    }

    lcd12864GdramAccessLock=0;
}

bit lcd12864PixelGet(unsigned char row,unsigned char col,bit frame){
    row%=64;
    col%=128;
    col+=(row>31)*128;
    row%=32;

    return lcd12864GdramBuffer[row][col/8][frame]&(0x80>>col%8)!=0;
}

void lcd12864FlushAtNextUpdate(){
    lcd12864GdramNeedsFlush=1;
}

#endif
